/* 中文说明：来自 iStoreOS 25.12 的设备树；三款设备分别编译。 */
/ {
	reserved-memory {
		#address-cells = <2>;
		#size-cells = <2>;
		ranges;

		ramoops: ramoops@110000 {
			compatible = "ramoops";
			reg = <0 0x110000 0 0xf0000>;
			console-size = <0x80000>;
			ftrace-size = <0x00000>;
			pmsg-size = <0x50000>;
			record-size = <0x20000>;
		};
	};
};
